## diagnostic_idle/sdkconfig.defaults
```kconfig
CONFIG_IDF_TARGET="esp32c3"
CONFIG_ESP_DEFAULT_CPU_FREQ_MHZ_80=y
CONFIG_ESP_DEFAULT_CPU_FREQ_MHZ=80
CONFIG_ESP_CONSOLE_UART_DEFAULT=y
```

## main/Kconfig.projbuild
```kconfig
menu "WS2812 流水灯配置"

config WS2812_GPIO
    int "WS2812 数据引脚 GPIO"
    range 0 21
    default 8
    help
        连接到第一颗 WS2812 灯珠 DIN 的 GPIO 引脚。

config WS2812_FRAME_INTERVAL_MS
    int "动画帧间隔（毫秒）"
    range 5 100
    default 20

endmenu
```

## sdkconfig.defaults
```kconfig
CONFIG_IDF_TARGET="esp32c3"
CONFIG_FREERTOS_HZ=1000
CONFIG_ESP_TASK_WDT_TIMEOUT_S=10
CONFIG_BT_ENABLED=y
CONFIG_BT_NIMBLE_ENABLED=y
CONFIG_ESPTOOLPY_FLASHSIZE_4MB=y
CONFIG_PARTITION_TABLE_CUSTOM=y
CONFIG_PARTITION_TABLE_CUSTOM_FILENAME="partitions_ota_4mb.csv"
CONFIG_BOOTLOADER_APP_ROLLBACK_ENABLE=y
CONFIG_PM_ENABLE=y
CONFIG_ESP_DEFAULT_CPU_FREQ_MHZ_80=y
CONFIG_ESP_DEFAULT_CPU_FREQ_MHZ=80
CONFIG_ESP_DEFAULT_CPU_FREQ_MHZ_160=n
CONFIG_BT_CTRL_MODEM_SLEEP=y
CONFIG_FREERTOS_USE_TICKLESS_IDLE=y
```
